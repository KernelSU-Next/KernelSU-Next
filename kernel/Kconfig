## kernel/Kconfig
```kconfig
menu "KernelSU"

config KSU
	tristate "KernelSU function support"
	depends on KPROBES && EXT4_FS
	default y
	help
	  Enable kernel-level root privileges on Android System.
	  Requires CONFIG_KPROBES for kernel hooking support.
	  Requires CONFIG_EXT4_FS for `ext4_unregister_sysfs`.
	  To compile as a module, choose M here: the
	  module will be called kernelsu.

config KSU_DEBUG
	bool "KernelSU debug mode"
	depends on KSU
	default n
	help
	  Enable KernelSU debug mode.

config KSU_DISABLE_MANAGER
	bool "Disable KernelSU manager integration"
	depends on KSU
	default n
	help
	  Disable manager APK detection and manager-specific handling.
	  Root will be used in place of manager-only functionality.

config KSU_DISABLE_POLICY
	bool "Disable KernelSU policy profiles"
	depends on KSU
	default n
	help
	  Disable per-app root/non-root profile customization.
	  Escalation will always use the default full root profile, and
	  non-root handling will follow the global umount policy only.

config KSU_X86_PATCH_SYSCALL_DISPATCHER
	bool "Dynamically patch x64's hardened syscall dispatcher to support syscall hooks"
	depends on KSU && X86_64
	default n
	help
	  Dynamically patch x64's hardened syscall dispatcher to support syscall hooks. This is a
	  replacement for a kernel source code patch, and is useful for x86_64 LKM mode.

config KSU_SAMSUNG_KDP
	bool "Samsung KDP credential compatibility"
	depends on KSU && ARM64
	default y
	help
	  Use Samsung KDP helpers when they are present. Kernels without KDP
	  helpers automatically use the standard credential APIs.

config KSU_SAMSUNG_RKP
	bool "Samsung RKP hook compatibility"
	depends on KSU && ARM64 && KPROBES && KRETPROBES
	default y
	help
	  Use kprobe-based syscall fallbacks on Samsung devices when patching
	  the syscall-table dispatcher is blocked. Samsung devices are detected
	  from the root device-tree compatible property. The fallback is not
	  used when the syscall table or an unused syscall slot cannot be found.

config KSU_SAMSUNG_DEFEX
	bool "Samsung DEFEX credential compatibility"
	depends on KSU && ARM64 && KPROBES
	default y
	help
	  Synchronize task credentials and bypass duplicate enforcement when
	  Samsung DEFEX helpers are present. Otherwise this option is a no-op.

config KSU_SAMSUNG_NO_PATCH_TEXT
	bool "Disable live kernel text/data patching on Samsung EL2"
	depends on KSU && ARM64
	default y
	help
	  Disable KernelSU's live patch helper on Samsung devices whose EL2
	  protection rejects fixmap writes. Samsung devices are detected from
	  the root device-tree compatible property; other devices are unaffected.

endmenu
```
